## arch/arm64/Kconfig.projects
```kconfig
config SEC_A42XQ_PROJECT
	default n
	bool "Samsung A42XQ Project"
	help
	  Support for Samsung A42XQ Project

config MACH_A42XQ_EUR_OPEN
	default n
	bool "Samsung A42XQ EUR OPEN"
	help
	  Support for Samsung A42XQ EUR OPEN device.

config SEC_GTS7XLLITE_PROJECT
	default n
	bool "Samsung GTS7XLLITE Project"
	help
	  Support for Samsung GTS7XLLITE Project

config MACH_GTS7XLLITE_EUR_OPEN
	default n
	bool "Samsung GTS7XLLITE EUR OPEN"
	help
	  Support for Samsung GTS7XLLITE EUR OPEN device.

config MACH_GTS7XLLITEWIFI_EUR_OPEN
	default n
	bool "Samsung GTS7XLLITEWIFI EUR OPEN"
	help
	  Support for Samsung GTS7XLLITEWIFI EUR OPEN device.
```
